;
;  standard hrum decompressor by hrumer
;  (trivially) modified by spke (08/09/2017)
;
;  this decompressor is, basically, disassembled version of the standard hrum
;  decompressor, with some format changes needed to use header-less files
;  generated by the optimal packer for hrum by lvd. the compressor is called using
;
;  mhmt.exe -hrm inputfile outputfile.hrum
;
;  the decompression is done in a standard way:
;
;  ld hl,compressed_data
;  ld de,where_to_decompress
;  call UnHrum
;
;  the decompressor modifies AF, BC, DE, HL, BC', DE', HL'
;  the relocatable version also modifies IX
;
;  drop me an email if you have any comments/ideas/suggestions: zxintrospec@gmail.com
;


	DEFINE	RELOCATABLE					; this makes unpacker relocatable (slightly longer unpaker + uses IX)



UnHrum:
	IFDEF	RELOCATABLE
		ld ix,0 : add ix,sp				; save SP into IX
	ELSE
		ld (SavedSP),sp
	ENDIF
		ld sp,hl : ld b,0				; SP = compressed source
		exx						; DE' = destination
		ld bc,#1010 : ld d,3
		pop hl						; first word in the stream contains the bitstream

		; third byte of the stream is always
		; a literal (first byte to be outputted)
CopyLiteral:	dec sp : pop af
		exx
		ld (de),a : inc de

l_c02d:         exx
		add hl,hl : djnz $+4 : pop hl : ld b,c
		jr c,CopyLiteral

		ld e,1
l_c037:		ld a,128
l_c039:		add hl,hl : djnz $+4 : pop hl : ld b,c
l_c03e:		rla
		jr c,l_c039
		cp d
		jr c,l_c049
		add a,e
		ld e,a
		xor c
		jr nz,l_c037

l_c049:		add a,e
		cp d
		ccf
		jr nc, l_c057

		sbc a,d
		jr z, l_c079
		adc a,d

l_c052: 	add hl,hl : djnz $+4 : pop hl : ld b,c

l_c057:		exx
		ld c,a
		ld h,#FF
		dec a
		ld a,#3F
		jr z,l_c064
		jr nc,l_c071
		res 5,a
l_c064:		exx
l_c065:		add hl,hl : djnz $+4 : pop hl : ld b,c
l_c06a:		rla
		jr nc,l_c065
		exx
		jr z,l_c073
		ld h,a

l_c071:		dec sp : pop af
l_c073:		ld l,a
		add hl,de
		ldir
		jr l_c02d

l_c079:		dec sp : pop af
		and a
		jr nz,l_c052

	IFDEF	RELOCATABLE
		ld sp,ix					; save SP into IX
	ELSE
SavedSP:	EQU $+1
		ld sp,0
	ENDIF
		ret



