/**
  Copyright © 2015 Odzhan. All Rights Reserved.

  Redistribution and use in source and binary forms, with or without
  modification, are permitted provided that the following conditions are
  met:

  1. Redistributions of source code must retain the above copyright
  notice, this list of conditions and the following disclaimer.

  2. Redistributions in binary form must reproduce the above copyright
  notice, this list of conditions and the following disclaimer in the
  documentation and/or other materials provided with the distribution.

  3. The name of the author may not be used to endorse or promote products
  derived from this software without specific prior written permission.

  THIS SOFTWARE IS PROVIDED BY AUTHORS "AS IS" AND ANY EXPRESS OR
  IMPLIED WARRANTIES, INCLUDING, BUT NOT LIMITED TO, THE IMPLIED
  WARRANTIES OF MERCHANTABILITY AND FITNESS FOR A PARTICULAR PURPOSE ARE
  DISCLAIMED. IN NO EVENT SHALL THE AUTHOR BE LIABLE FOR ANY DIRECT,
  INDIRECT, INCIDENTAL, SPECIAL, EXEMPLARY, OR CONSEQUENTIAL DAMAGES
  (INCLUDING, BUT NOT LIMITED TO, PROCUREMENT OF SUBSTITUTE GOODS OR
  SERVICES; LOSS OF USE, DATA, OR PROFITS; OR BUSINESS INTERRUPTION)
  HOWEVER CAUSED AND ON ANY THEORY OF LIABILITY, WHETHER IN CONTRACT,
  STRICT LIABILITY, OR TORT (INCLUDING NEGLIGENCE OR OTHERWISE) ARISING IN
  ANY WAY OUT OF THE USE OF THIS SOFTWARE, EVEN IF ADVISED OF THE
  POSSIBILITY OF SUCH DAMAGE. */

#define R(v,n)(((v)<<(n))|((v)>>(32-(n))))
#define F(n)for(i=0;i<n;i++)
#define X(a,b)(t)=(a),(a)=(b),(b)=(t)
typedef unsigned int W;

void P(W*s,W*x){
    W a,b,c,d,i,t,r;
    W v[8]={0xC840,0xD951,0xEA62,0xFB73,
            0xFA50,0xCB61,0xD872,0xE943};
            
    F(16)x[i]=s[i];
    
    F(80){
      d=v[i%8];
      a=(d&15);b=(d>>4&15);
      c=(d>>8&15);d>>=12;
      
      for(r=0x07080C10;r;r>>=8)
        x[a]+=x[b],
        x[d]=R(x[d]^x[a],(r&255)),
        X(a,c),X(b,d);
    }
    F(16)x[i]+=s[i];
    s[12]++;
}
void chacha(W l,void*in,void*state){
    unsigned char c[64],*p=in;
    W i,r,*s=state,*k=in;

    if(l){
      while(l){
        P(s,(W*)c);
        r=(l>64)?64:l;
        F(r)*p++^=c[i];
        l-=r;
      }
    }else{
      s[0]=0x61707865;s[1]=0x3320646E;
      s[2]=0x79622D32;s[3]=0x6B206574;
      F(12)s[i+4]=k[i];
    }
}

#ifdef TEST

#include <stdint.h>
#include <string.h>
#include <stdlib.h>
#include <stdio.h>

// 2.4.2.  Example and Test Vector for the ChaCha20 Cipher
uint8_t key[32]=
{ 0x00,0x01,0x02,0x03,0x04,0x05,0x06,0x07,
  0x08,0x09,0x0a,0x0b,0x0c,0x0d,0x0e,0x0f,
  0x10,0x11,0x12,0x13,0x14,0x15,0x16,0x17,
  0x18,0x19,0x1a,0x1b,0x1c,0x1d,0x1e,0x1f };

uint8_t nonce[12]=
{ 0x00,0x00,0x00,0x00,0x00,0x00,0x00,0x4a,
  0x00,0x00,0x00,0x00 };

// Plaintext Sunscreen:
uint8_t input[]=
{ 0x4c,0x61,0x64,0x69,0x65,0x73,0x20,0x61,
  0x6e,0x64,0x20,0x47,0x65,0x6e,0x74,0x6c,
  0x65,0x6d,0x65,0x6e,0x20,0x6f,0x66,0x20,
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  0x74,0x2e };

uint8_t output[]=
{ 0x6e,0x2e,0x35,0x9a,0x25,0x68,0xf9,0x80,
  0x41,0xba,0x07,0x28,0xdd,0x0d,0x69,0x81,
  0xe9,0x7e,0x7a,0xec,0x1d,0x43,0x60,0xc2,
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  0x87,0x4d };

typedef struct _cc_ctx {
    uint8_t key[32], ctr[4], nonce[12];
} cc_state;

int main (void) {

  cc_state p,s;
  int      ctr=1,equ,i;
  w        *r=(w*)&s;
  
  memset(&s, 0, sizeof(s));

  memcpy(p.key, key, 32);
  memcpy(p.ctr, &ctr, 4);
  memcpy(p.nonce, nonce, 12);

  xchacha20(0,&p,&s);

  printf ("\ncounter = %08x\n", r[12]);

  for (i=0; i<16; i+= 2) {
    printf ("state[%02i - %02i] = 0x%08x 0x%08x\n",
      i, i+1, r[i], r[i+1]);
  }

  xchacha20(64,input,&s);

  equ=(memcmp (input, output, 64)==0);
  printf ("\nEncryption test %s", equ ? "passed":"failed");
  return 0;
}
#endif