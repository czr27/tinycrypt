
/**
  Copyright © 2016,2018 Odzhan. All Rights Reserved.

  Redistribution and use in source and binary forms, with or without
  modification, are permitted provided that the following conditions are
  met:

  1. Redistributions of source code must retain the above copyright
  notice, this list of conditions and the following disclaimer.

  2. Redistributions in binary form must reproduce the above copyright
  notice, this list of conditions and the following disclaimer in the
  documentation and/or other materials provided with the distribution.

  3. The name of the author may not be used to endorse or promote products
  derived from this software without specific prior written permission.

  THIS SOFTWARE IS PROVIDED BY AUTHORS "AS IS" AND ANY EXPRESS OR
  IMPLIED WARRANTIES, INCLUDING, BUT NOT LIMITED TO, THE IMPLIED
  WARRANTIES OF MERCHANTABILITY AND FITNESS FOR A PARTICULAR PURPOSE ARE
  DISCLAIMED. IN NO EVENT SHALL THE AUTHOR BE LIABLE FOR ANY DIRECT,
  INDIRECT, INCIDENTAL, SPECIAL, EXEMPLARY, OR CONSEQUENTIAL DAMAGES
  (INCLUDING, BUT NOT LIMITED TO, PROCUREMENT OF SUBSTITUTE GOODS OR
  SERVICES; LOSS OF USE, DATA, OR PROFITS; OR BUSINESS INTERRUPTION)
  HOWEVER CAUSED AND ON ANY THEORY OF LIABILITY, WHETHER IN CONTRACT,
  STRICT LIABILITY, OR TORT (INCLUDING NEGLIGENCE OR OTHERWISE) ARISING IN
  ANY WAY OUT OF THE USE OF THIS SOFTWARE, EVEN IF ADVISED OF THE
  POSSIBILITY OF SUCH DAMAGE. */
// cubehash with parameters: b=1, r=1, i=10, f=10, h=256
#define R(v,n)(((v)<<(n))|((v)>>(32-(n))))
#define F(n)for(i=0;i<n;i++)
typedef unsigned int W;
typedef unsigned char B;

void P(void*b,W n){
  W i,j,k,y[16],*x=b;
  
  while(n--){
    for(k=7,j=2;j>0;k+=4,j--){
      F(16)x[i+16]+=x[i];
      F(16)y[i^j*4]=x[i];
      F(16)x[i]=R(y[i],k);
      F(16)x[i]^=x[i+16];
      F(16)y[i^j]=x[i+16];
      F(16)x[i+16]=y[i];
    }
  }
}
void cubehash(W l,void*in,void*out){
  W i;B x[128],*p=in;

  F(128)x[i]=0;*x=32;x[4]=x[8]=1;P(x,10);
  F(l)*x^=*p++,P(x,1);
  *x^=128;P(x,1);
  x[124]^=1;P(x,10);
  F(32)((B*)out)[i]=x[i];
}

#ifdef TEST

#include <stdio.h>
#include <string.h>
#include <stdint.h>

B s1[]=
{0x80,0xf7,0x2e,0x07,0xd0,0x4d,0xda,0xdb,
 0x44,0xa7,0x88,0x23,0xe0,0xaf,0x2e,0xa9,
 0xf7,0x2e,0xf3,0xbf,0x36,0x6f,0xd7,0x73,
 0xaa,0x1f,0xa3,0x3f,0xc0,0x30,0xe5,0xcb};

B s2[]=
{0xd1,0xbc,0xae,0x75,0x78,0xb5,0xa3,0x45,
 0x68,0x3a,0x72,0xbe,0x98,0x16,0xd0,0x51,
 0x16,0x29,0xd5,0xd7,0x75,0x90,0x51,0xa1,
 0x04,0x80,0x18,0x76,0x6c,0x8d,0xa8,0x9e};

B s3[]=
{0x6d,0x63,0xca,0x66,0xe0,0xa5,0x12,0x47,
 0x97,0xbf,0x84,0x07,0x18,0x00,0x27,0x40,
 0x72,0x7b,0x86,0x62,0x84,0x89,0x63,0xa7,
 0x3c,0xf4,0x9b,0x21,0xcf,0xa8,0xf6,0xe6};

B s4[]=
{0xcf,0x8d,0xf1,0xb7,0x30,0x14,0xfc,0x4f,
 0xea,0x6f,0xce,0x64,0xf8,0x40,0x29,0xff,
 0x03,0x85,0xe5,0xb0,0x8b,0x8d,0xf5,0xe8,
 0x33,0x23,0xfb,0xa8,0x6e,0xc6,0x9f,0xe1};

B s5[]=
{0x29,0x73,0xec,0xe3,0x4a,0x25,0x40,0x78,
 0x9a,0x02,0xea,0x44,0x21,0x8e,0x20,0x9c,
 0xa7,0x3f,0x18,0x4b,0xfa,0xdd,0xf1,0x83,
 0x66,0xf8,0xe7,0xc6,0xca,0x00,0xa7,0x83};

B s6[]=
{0xf2,0xd1,0xe7,0xb8,0x82,0x79,0x43,0xb7,
 0x24,0xf1,0x5a,0x9c,0x63,0x4c,0xa2,0xad,
 0xf1,0xe7,0x69,0xdb,0x41,0x16,0x70,0x74,
 0x7d,0xed,0x3a,0x56,0x2b,0x69,0xf4,0xfa};

B s7[]=
{0xf5,0x27,0x28,0xf9,0x37,0x99,0xa8,0x7a,
 0x7f,0xd2,0x15,0xf0,0x40,0x24,0x25,0x88,
 0x43,0xb9,0xd0,0x31,0x84,0x8f,0x93,0xeb,
 0xc3,0x2d,0xec,0x2c,0x1a,0xf8,0x1d,0x53};

B s8[]=
{0x21,0x7a,0x48,0x76,0xf2,0xb2,0x4c,0xec,
 0x48,0x9c,0x91,0x71,0xf8,0x5d,0x53,0x39,
 0x5c,0xc9,0x79,0x15,0x6e,0xa0,0x25,0x49,
 0x38,0xc4,0xc2,0xc5,0x9d,0xfd,0xf8,0xa4};

B s9[]=
{0xf6,0x30,0x41,0xa9,0x46,0xaa,0x98,0xbd,
 0x47,0xf3,0x17,0x5e,0x60,0x09,0xdc,0xb2,
 0xcc,0xf5,0x97,0xb2,0x71,0x86,0x17,0xba,
 0x46,0xd5,0x6f,0x27,0xff,0xe3,0x5d,0x49};

B *tv_h[]={s1,s2,s3,s4,s5,s6,s7,s8,s9};

char *tv_p[] =
{ "",
  "a",
  "abc",
  "message digest",
  "abcdefghijklmnopqrstuvwxyz",
  "ABCDEFGHIJKLMNOPQRSTUVWXYZabcdefghijklmnopqrstuvwxyz0123456789",
  "12345678901234567890123456789012345678901234567890123456789012345678901234567890",
  "The quick brown fox jumps over the lazy dog",
  "Hello"
};

void bin2hex(uint8_t x[], int len) {
    int i;
    for (i=0; i<len; i++) {
      if ((i & 7)==0) putchar('\n');
      printf ("0x%02x,", x[i]);
    }
    putchar('\n');
}

int main(void){
  
  B h[32];
  W i,e;
  
  for(i=0;i<9;i++){
    cubehash(strlen(tv_p[i]),tv_p[i],h);
    e=(memcmp(h,tv_h[i],32)==0);
    printf("CubeHash10+1/1+10-256 Test #%i : %s\n", 
      (i+1),e?"OK":"FAILED");
    if(!e) bin2hex(h,32);
  }
  return 0;
}
#endif
