/**
  Copyright © 2015 Odzhan. All Rights Reserved.

  Redistribution and use in source and binary forms, with or without
  modification, are permitted provided that the following conditions are
  met:

  1. Redistributions of source code must retain the above copyright
  notice, this list of conditions and the following disclaimer.

  2. Redistributions in binary form must reproduce the above copyright
  notice, this list of conditions and the following disclaimer in the
  documentation and/or other materials provided with the distribution.

  3. The name of the author may not be used to endorse or promote products
  derived from this software without specific prior written permission.

  THIS SOFTWARE IS PROVIDED BY AUTHORS "AS IS" AND ANY EXPRESS OR
  IMPLIED WARRANTIES, INCLUDING, BUT NOT LIMITED TO, THE IMPLIED
  WARRANTIES OF MERCHANTABILITY AND FITNESS FOR A PARTICULAR PURPOSE ARE
  DISCLAIMED. IN NO EVENT SHALL THE AUTHOR BE LIABLE FOR ANY DIRECT,
  INDIRECT, INCIDENTAL, SPECIAL, EXEMPLARY, OR CONSEQUENTIAL DAMAGES
  (INCLUDING, BUT NOT LIMITED TO, PROCUREMENT OF SUBSTITUTE GOODS OR
  SERVICES; LOSS OF USE, DATA, OR PROFITS; OR BUSINESS INTERRUPTION)
  HOWEVER CAUSED AND ON ANY THEORY OF LIABILITY, WHETHER IN CONTRACT,
  STRICT LIABILITY, OR TORT (INCLUDING NEGLIGENCE OR OTHERWISE) ARISING IN
  ANY WAY OUT OF THE USE OF THIS SOFTWARE, EVEN IF ADVISED OF THE
  POSSIBILITY OF SUCH DAMAGE. */

#define R(v,n)(((v)>>(n))|((v)<<(32-(n))))
#define F(n)for(i=0;i<n;i++)
#define X(a,b)(t)=(a),(a)=(b),(b)=(t)
typedef unsigned int W;
typedef unsigned long long Q;

void chacha(W len, void *data, void *state);

#ifndef ASM
void chacha20_core(void *in, void *out) {
    W a,b,c,d,i,t,r,*s=in,*x=out;
    W v[8]={0xC840,0xD951,0xEA62,0xFB73,
            0xFA50,0xCB61,0xD872,0xE943};
            
    // load state into local buffer
    F(16)x[i]=s[i];
    
    // for 80 rounds
    F(80) {
      d=v[i%8];
      a=(d&15);b=(d>>4&15);
      c=(d>>8&15);d>>=12;
      
      for(r=0x19181410;r;r>>=8)
        x[a]+=x[b],
        x[d]=R(x[d]^x[a],(r&255)),
        // swap
        X(a,c),X(b,d);
    }
    // add state to local buffer
    F(16)x[i]+=s[i];
}
void chacha(W len, void *data, void *state) {
    unsigned char c[64],*p=data;
    W i,r,*s=state,*k=data;

    // if we have data to encrypt/decrypt
    if(len) {
      while(len) {
        // permute state
        chacha20_core(s, c);
      #ifdef GX
        s[12]++;
      #else
        ((Q*)s)[6]++;
      #endif
        r = (len > 64) ? 64 : len;
        // xor plaintext with ciphertext
        F(r)p[i] ^= c[i];
        // decrease length
        len-=r;
        p+=r;
      }
    // initialize state
    } else {
      s[0] = 0x61707865; s[1] = 0x3320646E;
      s[2] = 0x79622D32; s[3] = 0x6B206574;
      F(8) s[i+4] = k[i];
    #ifdef GX
      // set 32-bit counter
      s[12] = 1;
      // copy 96-bit nonce
      F(3)s[i+13] = k[i+8];
    #else
      // set 64-bit counter
      s[12] = 0; s[13] = 0;
      // copy 64-bit nonce
      F(2)s[i+14] = k[i+8];
    #endif
    }
}
#endif

#ifdef TEST

#include <stdio.h>
#include <stdint.h>
#include <string.h>
#include <stdlib.h>

#ifdef GX
// 2.4.2.  Example and Test Vector for the ChaCha20 Cipher
uint8_t tv_key[]=
{ 0x00,0x01,0x02,0x03,0x04,0x05,0x06,0x07,
  0x08,0x09,0x0a,0x0b,0x0c,0x0d,0x0e,0x0f,
  0x10,0x11,0x12,0x13,0x14,0x15,0x16,0x17,
  0x18,0x19,0x1a,0x1b,0x1c,0x1d,0x1e,0x1f };
      
uint8_t tv_nonce[]=
{ 0x00,0x00,0x00,0x00,0x00,0x00,0x00,0x4a,
  0x00,0x00,0x00,0x00 };

// Plaintext Sunscreen:
uint8_t tv_plaintext[]=
{ 0x4c,0x61,0x64,0x69,0x65,0x73,0x20,0x61,
  0x6e,0x64,0x20,0x47,0x65,0x6e,0x74,0x6c,
  0x65,0x6d,0x65,0x6e,0x20,0x6f,0x66,0x20,
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  0x74,0x2e };
  
// Ciphertext Sunscreen:
uint8_t tv_stream[]=
{ 0x6e,0x2e,0x35,0x9a,0x25,0x68,0xf9,0x80,
  0x41,0xba,0x07,0x28,0xdd,0x0d,0x69,0x81,
  0xe9,0x7e,0x7a,0xec,0x1d,0x43,0x60,0xc2,
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  0x87,0x4d }; 

#else
// 256-bit key
uint8_t tv_key[32] = {
  0xf0, 0xb2, 0x48, 0x1d, 0x6b, 0x24, 0xd0, 0x18,
  0x03, 0x6a, 0x9e, 0x3d, 0x03, 0xc9, 0x7b, 0x1d,
  0x9e, 0x4b, 0x46, 0x6b, 0x01, 0x7d, 0xde, 0x25,
  0xcb, 0x9c, 0x6a, 0x00, 0xfa, 0xda, 0xac, 0x11 };

// 64-bit nonce
uint8_t tv_nonce[8] = {
  0x1b, 0xec, 0x52, 0xf7, 0xfc, 0xcc, 0x95, 0x24 };

// 512-bit stream after 2048 blocks of keystream
uint8_t tv_stream[64] = {
  0x97, 0x9d, 0x8e, 0x1f, 0xe7, 0x51, 0xb3, 0xba, 
  0xb0, 0x8e, 0x95, 0x59, 0x62, 0xb8, 0x30, 0x67, 
  0x19, 0x03, 0x06, 0xb5, 0xc6, 0xf3, 0x4c, 0x56, 
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  0x50, 0xd1, 0x16, 0xd0, 0xfc, 0xba, 0xb6, 0x07 };

#endif

// 512-bit output after 2048 iterations of permutation function
uint8_t tv_perm[64] = {
  0x0e, 0x3f, 0x8e, 0x6e, 0xf7, 0x87, 0x07, 0x95, 
  0xdb, 0xb6, 0x03, 0x09, 0xaa, 0x0e, 0x55, 0x7d, 
  0xf7, 0xa3, 0xd2, 0x86, 0x90, 0x6d, 0xc7, 0xc3, 
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  0xf7, 0x38, 0x6d, 0xed, 0x09, 0x3a, 0x87, 0x0d };

void bin2hex(const char *s, void *bin, int len) {
    int  i;
    char c;
    uint8_t *b=bin;
    
    printf ("\n%s=", s);
    
    for (i=0; i<len; i++) {
      if ((i & 7)==0) putchar('\n');
      if (i==len-1) c='\n'; else c=',';
      printf ("0x%02x%c ", b[i], c);
    }
}

int main(void) {
    uint8_t state[64], stream[1024], key_iv[48];
    int     i, equ;
    
  #ifndef ASM
    // test the permutation function first
    for(i=0;i<64;i++) state[i]=(i+1);
    
    for(i=0;i<2048;i++) {
      chacha20_core(state, stream);
    }
    equ = (memcmp(stream, tv_perm, 64)==0);

    printf("chacha20 core test : %s\n", equ ? "OK" : "FAILED");
  #endif
  
    memcpy(key_iv, tv_key, sizeof(tv_key));
    memcpy(&key_iv[32], tv_nonce, sizeof(tv_nonce));
    chacha(0, key_iv, state);
  #ifdef GX
    memcpy(stream, tv_plaintext, sizeof(tv_plaintext));
    chacha(sizeof(tv_plaintext), stream, state);
  #else
    for(i=0;i<2048;i++) {
      memset(stream, 0, 64);
      chacha(64, stream, state);
    }
  #endif
    equ = (memcmp(stream, tv_stream, sizeof(tv_stream))==0);
    printf("chacha20 keystream test : %s\n", equ ? "OK" : "FAILED");
    return 0;
}
#endif
